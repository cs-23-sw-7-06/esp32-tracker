## main/Kconfig.projbuild
```kconfig
menu "Sniffer Configuration"

  config API_HOSTNAME
    string "The hostname of the API endpoint (can be an IP address)"
    default "10.0.0.1"
    help
      "Specify a hostname or an ip address"

  config API_PORT
    int "The port where the API endpoint is hosted"
    range 1 65535
    default 8081
    help
      "No help :)"

  config WIFI_SSID
    string "The ssid to connect to"
    default "CentralHub"
    help
      "No help for you :)"

  config WIFI_PASSWORD
    string "The password to use when connecting"
    default ""
    help
      "No help for you :)"

  config WIFI_RETRY_COUNT
    int "How many times to retry if we lose wifi connection"
    range 0 10
    default 3
    help
      "No help :)"


  config WIFI_SNIFFER_SNIFF_TIME
    int "The time in milliseconds to sniff for packets"
    range 500 20000
    default 10000
    help
      "No help :)"

  config BLUETOOTH_CLASSIC_SCANNER_SCAN_TIME
    int "The time in milliseconds to scan for bluetooth classic devices"
    range 500 20000
    default 10000
    help
      "No help :)"

endmenu
```
